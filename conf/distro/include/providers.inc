## conf/distro/include/providers.inc
```bitbake
#
# Prefer MicroOS packages instead of Poky when conflict
#
PREFERRED_RPROVIDER_/usr/bin/awk ?= "gawk"
PREFERRED_RPROVIDER_/usr/bin/cat ?= "coreutils"
PREFERRED_RPROVIDER_/usr/bin/mkdir ?= "coreutils"
PREFERRED_RPROVIDER_/usr/bin/sed ?= "coreutils"
PREFERRED_RPROVIDER_/usr/bin/touch ?= "coreutils"
PREFERRED_RPROVIDER_/usr/bin/grep ?= "coreutils"
PREFERRED_RPROVIDER_/usr/bin/mv ?= "coreutils"
PREFERRED_RPROVIDER_/usr/bin/mktemp ?= "coreutils"

PREFERRED_RPROVIDER_dbus-launch ?= "dbus-1-x11"
PREFERRED_RPROVIDER_gdbm ?= "libgdbm6"
PREFERRED_RPROVIDER_gettext ?= "gettext-runtime"
PREFERRED_RPROVIDER_gettext-runtime ?= "gettext-runtime"
PREFERRED_RPROVIDER_gettext-runtime-dev ?= "gettext-runtime"
PREFERRED_RPROVIDER_group-lp ?= "system-group-hardware"
PREFERRED_RPROVIDER_libgpg-error ?= "libgpg-error0"
PREFERRED_RPROVIDER_libksba ?= "libksba8"
PREFERRED_RPROVIDER_libsolv-tools ?= "libsolv-tools"
PREFERRED_RPROVIDER_libxml2 ?= "libxml2-tools"
PREFERRED_RPROVIDER_libz.so.1 ?= "libz1"
PREFERRED_RPROVIDER_ncurses ?= "ncurses"
PREFERRED_RPROVIDER_procps ?= "procps"
PREFERRED_RPROVIDER_python3 ?= "python3"
PREFERRED_RPROVIDER_python3-asyncio ?= "python3"
PREFERRED_RPROVIDER_python3-curses ?= "python3"
PREFERRED_RPROVIDER_python3-sqlite3 ?= "python3"
PREFERRED_RPROVIDER_python3-xml ?= "python3"
PREFERRED_RPROVIDER_readline ?= "libreadline8"
PREFERRED_RPROVIDER_systemd-default-settings-branding ?= "systemd-default-settings-branding-opensuse"
PREFERRED_RPROVIDER_systemd-presets-branding ?= "systemd-presets-branding-microos"
PREFERRED_RPROVIDER_zlib ?= "libz1"
```

## conf/distro/include/tcmode-external-microos.inc
```bitbake
#
# Configuration to use the external MicroOS toolchain
#

EXTERNAL_TOOLCHAIN ?= "/usr/local/cross-sdk"
TARGET_PREFIX = "${TARGET_ARCH}-suse-${TARGET_OS}-"

TOOLCHAIN_PATH_ADD = "${EXTERNAL_TOOLCHAIN}/usr/bin:"
PATH =. "${TOOLCHAIN_PATH_ADD}"

# Blacklist toolchain recipes as a belt-and-suspenders way to use the external toolchain
SKIP_RECIPE[libgcc] = "Using external toolchain"
SKIP_RECIPE[libgcc-initial] = "Using external toolchain"
SKIP_RECIPE[gcc-cross] = "Using external toolchain"
SKIP_RECIPE[gcc-cross-aarch64] = "Using external toolchain"
SKIP_RECIPE[gcc-cross-arm] = "Using external toolchain"
SKIP_RECIPE[gcc-runtime] = "Using external toolchain"
SKIP_RECIPE[gcc-sanitizers] = "Using external toolchain"

PREFERRED_PROVIDER_virtual/${TARGET_PREFIX}compilerlibs = "external-microos-toolchain"
PREFERRED_PROVIDER_virtual/${TARGET_PREFIX}g++ = "external-microos-toolchain"
PREFERRED_PROVIDER_virtual/${TARGET_PREFIX}gcc = "external-microos-toolchain"
PREFERRED_PROVIDER_virtual/${TARGET_PREFIX}gcc-initial = "external-microos-toolchain"
PREFERRED_PROVIDER_virtual/${TARGET_PREFIX}libc-for-gcc = "external-microos-toolchain"
PREFERRED_PROVIDER_virtual/linux-libc-headers = "external-microos-toolchain"

# TODO Should this be part of providers.inc?
PREFERRED_PROVIDER_virtual/crypt = "libcrypt1"

TARGET_LDFLAGS += "-L${STAGING_DIR_TARGET}/${libdir}64/gcc/${TARGET_ARCH}-suse-${TARGET_OS}/${MM_PRI_VER_GCC}"

# Validate the presence of the MicroOS external toolchain
python toolchain_metadata_setup () {
    import subprocess
    if not isinstance(e, bb.event.ConfigParsed):
        return

    d = e.data
    l = d.createCopy()

    external_toolchain = l.getVar("EXTERNAL_TOOLCHAIN", True)
    if not external_toolchain or external_toolchain == "UNDEFINED":
        bb.fatal("Error: EXTERNAL_TOOLCHAIN must be set to the path to your MicroOS toolchain")

    if not os.path.isabs(external_toolchain):
        bb.fatal(f"Error: EXTERNAL_TOOLCHAIN path '{external_toolchain}' must be absolute path")

    if not os.path.exists(external_toolchain):
        bb.fatal(f"Error: EXTERNAL_TOOLCHAIN path '{external_toolchain}' does not exist")
}
addhandler toolchain_metadata_setup


#
# Extract the version of the toolchain
#

def mm_run(d, cmd, *args):
    import bb.process
    import subprocess

    toolchain_path = d.getVar("EXTERNAL_TOOLCHAIN", True)
    if not toolchain_path:
        return "UNKNOWN", "UNKNOWN"

    target_prefix = d.getVar("TARGET_PREFIX", True)
    cmd = os.path.join(toolchain_path, "usr", "bin", f"{target_prefix}{cmd}")
    args = [cmd] + list(args)

    return bb.process.run(args, stderr=subprocess.PIPE)

def mm_get_version(d):
    try:
        stdout, stderr = mm_run(d, "gcc", "-v")
    except bb.process.CmdError as exc:
        bb.error(f"Failed to obtain external MicroOS toolchain version: {exc}")
        return "UNKNOWN"
    else:
        last_line = stderr.splitlines()[-1]
        return last_line

def mm_gcc_version(d):
    version = mm_get_version(d)
    if version != "UNKNOWN":
        # "gcc version xx.yy.zz ..."
        return version.split()[2]
    else:
        return version

python toolchain_version_handler() {
    if not isinstance(e, bb.event.ConfigParsed):
        return
    d = e.data
    ld = d.createCopy()

    d.setVar("MM_VER_GCC", mm_gcc_version(ld))
    d.setVar("MM_PRI_VER_GCC", mm_gcc_version(ld).split(".")[0])
}
addhandler toolchain_version_handler
```

## conf/distro/microos.conf
```bitbake
DISTRO = "microos"
DISTRO_NAME = "MicroOS (Develop for MicroOS with Yocto)"
DISTRO_VERSION = "20230604"
DISTRO_CODENAME = "microos"
# SDK_VENDOR = "-microossdk"
# SDK_VERSION = "${@d.getVar('DISTRO_VERSION').replace('snapshot-${METADATA_REVISION}', 'snapshot')}"
# SDK_VERSION[vardepvalue] = "${SDK_VERSION}"

MAINTAINER = "Alberto Planas <aplanas@suse.de>"

TARGET_VENDOR = "-microos"

LOCALCONF_VERSION = "2"

# Override these in microos based distros
# MICROOS_DEFAULT_DISTRO_FEATURES = "opengl ptest multiarch wayland vulkan"
# MICROOS_DEFAULT_EXTRA_RDEPENDS = "packagegroup-core-boot"
# MICROOS_DEFAULT_EXTRA_RRECOMMENDS = "kernel-module-af-packet"

# DISTRO_FEATURES ?= "${DISTRO_FEATURES_DEFAULT} ${MICRO_DEFAULT_DISTRO_FEATURES}"

# PREFERRED_VERSION_linux-yocto ?= "6.1%"
# PREFERRED_VERSION_linux-yocto-rt ?= "6.1%"

SDK_NAME = "${DISTRO}-${TCLIBC}-${SDKMACHINE}-${IMAGE_BASENAME}-${TUNE_PKGARCH}-${MACHINE}"
SDKPATHINSTALL = "/opt/${DISTRO}/${SDK_VERSION}"

# DISTRO_EXTRA_RDEPENDS += "${MICROOS_DEFAULT_EXTRA_RDEPENDS}"
# DISTRO_EXTRA_RRECOMMENDS += "${MICROOS_DEFAULT_EXTRA_RRECOMMENDS}"

TCLIBCAPPEND = ""

PACKAGE_CLASSES ?= "package_rpm"

SANITY_TESTED_DISTROS ?= " \
            poky-4.1 \n \
            poky-4.2 \n \
            ubuntu-18.04 \n \
            ubuntu-20.04 \n \
            ubuntu-22.04 \n \
            fedora-36 \n \
            fedora-37 \n \
            debian-11 \n \
            opensuseleap-15.3 \n \
            opensuseleap-15.4 \n \
            almalinux-8.7 \n \
            almalinux-9.1 \n \
            "
# add poky sanity bbclass
INHERIT += "poky-sanity"

# QA check settings - a little stricter than the OE-Core defaults
# (none currently necessary as we now match OE-Core)
#WARN_TO_ERROR_QA = "X"
#WARN_QA_remove = "${WARN_TO_ERROR_QA}"
#ERROR_QA_append = " ${WARN_TO_ERROR_QA}"

require conf/distro/include/poky-world-exclude.inc
require conf/distro/include/no-static-libs.inc
require conf/distro/include/yocto-uninative.inc
require conf/distro/include/security_flags.inc
INHERIT += "uninative"

BB_SIGNATURE_HANDLER ?= "OEEquivHash"
BB_HASHSERVE ??= "auto"

MICROOS_INIT_MANAGER = "systemd"
INIT_MANAGER ?= "${MICROOS_INIT_MANAGER}"

# We need debug symbols so that SPDX license manifests for the kernel work
KERNEL_EXTRA_FEATURES:append = " features/debug/debug-kernel.scc"

# Enable creation of SPDX manifests by default
INHERIT += "create-spdx"

# TCMODE = "external-microos"

require conf/distro/include/providers.inc
```

## conf/layer.conf
```bitbake
# We have a conf and classes directory, add to BBPATH
BBPATH .= ":${LAYERDIR}"

# We have recipes-* directories, add to BBFILES
BBFILES += "${LAYERDIR}/recipes-*/*/*.bb \
            ${LAYERDIR}/recipes-*/*/*.bbappend"

BBFILE_COLLECTIONS += "microos"
BBFILE_PATTERN_microos = "^${LAYERDIR}/"
BBFILE_PRIORITY_microos = "6"

LAYERDEPENDS_microos = "core"
LAYERSERIES_COMPAT_microos = "mickledore"

# Allocate directory for uncommon licenses
LICENSE_PATH += "${LAYERDIR}/licenses"
```
